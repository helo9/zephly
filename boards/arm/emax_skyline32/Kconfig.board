## boards/arm/emax_skyline32/Kconfig.board
```kconfig
# EMAX Skyline32 board configuration
#
# Copyright (c) 2022 Kevin Dominic Merkel
# SPDX-License-Identifier: Apache-2.0

config BOARD_EMAX_SKYLINE32
	bool "EMAX Skyline32 board"
	depends on SOC_STM32F103XB
```

## boards/arm/emax_skyline32/Kconfig.defconfig
```kconfig
if BOARD_EMAX_SKYLINE32

config BOARD
	default "emax_skyline32"

endif # BOARD_EMAX_SKYLINE32
```

## boards/arm/openpilot_cc3d/Kconfig.board
```kconfig
# OpenPilot CC3D board configuration
#
# Copyright (c) 2021 Jonathan Hahn
# SPDX-License-Identifier: Apache-2.0

config BOARD_OPENPILOT_CC3D
	bool "OpenPilot CC3D board"
	depends on SOC_STM32F103XB
```

## boards/arm/openpilot_cc3d/Kconfig.defconfig
```kconfig
if BOARD_OPENPILOT_CC3D

config BOARD
	default "openpilot_cc3d"

endif # BOARD_OPENPILOT_CC3D
```

## boards/arm/openpilot_cc3d/openpilot_cc3d_defconfig
```kconfig
# SPDX-License-Identifier: Apache-2.0

CONFIG_SOC_SERIES_STM32F1X=y
CONFIG_SOC_STM32F103XE=y

CONFIG_PINCTRL=y
CONFIG_PINCTRL_STM32=y

# enable uart driver
CONFIG_SERIAL=y
# enable console
CONFIG_CONSOLE=y
CONFIG_UART_CONSOLE=y

# enable pinmux
CONFIG_PINMUX=y

# disable jtag to get PB3 free
CONFIG_GPIO_STM32_SWJ_NOJTAG=y

# enable GPIO
CONFIG_GPIO=y

# enable clocks
CONFIG_CLOCK_CONTROL=y
```

## boards/arm/spracing_f3neo/Kconfig.board
```kconfig
# SPRacing F3 Neo board configuration
#
# Copyright (c) 2022 Jonathan Hahn
# SPDX-License-Identifier: Apache-2.0

config BOARD_SPRF3NEO
	bool "SPRacing F3 Neo board"
	depends on SOC_STM32F303XC
```

## boards/arm/spracing_f3neo/Kconfig.defconfig
```kconfig
if BOARD_SPRF3NEO

config BOARD
	default "spracing_f3neo"

endif # BOARD_SPRF3NEO
```

## boards/arm/spracing_f3neo/spracing_f3neo_defconfig
```kconfig
# SPDX-License-Identifier: Apache-2.0

CONFIG_SOC_SERIES_STM32F3X=y
CONFIG_SOC_STM32F303XC=y

# Floating Point Options
CONFIG_FPU=y

# Enable MPU
CONFIG_ARM_MPU=y

# Enable HW stack protection
CONFIG_HW_STACK_PROTECTION=y

# enable uart driver
CONFIG_SERIAL=y

# enable console
CONFIG_CONSOLE=y
CONFIG_UART_CONSOLE=y

# enable GPIO
CONFIG_GPIO=y

# Enable Clocks
CONFIG_CLOCK_CONTROL=y

# Enable pin controller
CONFIG_PINCTRL=y

# disable jtag to get PB3, PB4 free
CONFIG_GPIO_STM32_SWJ_NOJTAG=y

# Enable SPI
CONFIG_SPI=y

# Enable Sensors
CONFIG_SENSOR=y

# Enable IMU
CONFIG_ICM20602_DRIVER=y
```

## drivers/Kconfig
```kconfig
# Copyright (c) 2022 Jonathan Hahn
# SPDX-License-Identifier: Apache-2.0

menu "Drivers"

rsource "mpu6000/Kconfig"
rsource "rc/Kconfig"

endmenu
```

## drivers/control_output/pwm/Kconfig
```kconfig
# Copyright (c) 2022 Jonathan Hahn
# SPDX-License-Identifier: Apache-2.0

menuconfig CONTROL_OUTPUT_PWM
	bool "Control output via pwm"
	help
		Enable control output via pwm peripherals.

if CONTROL_OUTPUT_PWM

config CONTROL_OUTPUT_PWM_INIT_PRIORITY
	int "PWM output init priority"
	default 80
	help
		PWM output initialization priority.

config CONTROL_OUTPUT_PWM_PERIOD
	int "Time between two pwm cycles"
	default 20000
	help
		Defines the time between two pwm cycles.

config CONTROL_OUTPUT_PWM_MIN_DUTY
	int "Minimum duty cycle for pwm output"
	default 1000
	help
		Defines the minimum duty cycle for PWM output.

config CONTROL_OUTPUT_PWM_MAX_DUTY
	int "Maximum duty cycle for pwm output"
	default 2000
	help
		Defines the maximum duty cycle for PWM output.

endif #CONTROL_OUTPUT_PWM
```

## drivers/icm20602/Kconfig
```kconfig
menuconfig ICM20602_DRIVER
	bool "ICM20602 SPI driver"
	depends on LOG
	help
	  Enable ICM20602 SPI drivers.

if ICM20602_DRIVER

config ICM20602_TRIGGER
	bool "External data ready trigger"
	help
	  Enable ICM20602 data ready trigger.

config ICM20602_AFS_SEL
	int "Accelerometer Full Scale Selection"
	range 0 3
	default 1
	help
	  This option allows to select the accelerometer range.
	  0 -  2g
	  1 -  4g
	  2 -  8g
	  3 - 16g

config ICM20602_FS_SEL
	int "Gyrometer Full Scale Selection"
	range 0 3
	default 1
	help
	  This option allows to select the gyrometer range.
	  0 -  250 deg/s
	  1 -  500 deg/s
	  2 - 1000 deg/s
	  3 - 2000 deg/s 

config ICM20602_DLPF_GYRO_TEMP_CONFIG
	int "Digital Low Pass filter settings for gyro and temperature"
	range 0 7
	default 0
	help
	  This option allows to configure the integrated digital low pass filter and -3dB is reached at
	  0 -  250 Hz
	  1 -  176 Hz
	  2 -   92 Hz
	  3 -   41 Hz
	  4 -   20 Hz
	  5 -   10 Hz
	  6 -    5 Hz
	  7 - 3281 Hz

config ICM20602_DLPF_ACCEL_CONFIG
	  int "Digital Low Pass filter settings for accelerometer"
	  range 0 7
	  default 0
	  help
		This option allows to configure the integrated digital low pass filter and -3dB is reached at
		0 - 218.1 Hz
		1 - 218.1 Hz
		2 -  99.0 Hz
		3 -  44.8 Hz
		4 -  21.2 Hz
		5 -  10.2 Hz
		6 -   5.1 Hz
		7 - 420.0 Hz

config ICM20602_SAMPLE_RATE_DIVIDER
	int "Sample rate divider that controls the data ouput / fifo sample rate"
	range 1 255
	default 1
	help
	  This option allows to adapt the sample rate for measurement aquisition.

endif # ICM20602_DRIVER
```

## drivers/mpu6000/Kconfig
```kconfig
menuconfig MPU6000_DRIVER
	bool "MPU6000 SPI driver"
	help
	  Enable MPU6000 SPI drivers.

if MPU6000_DRIVER

config MPU6000_AFS_SEL
	int "Accelerometer Full Scale Selection"
	range 0 3
	default 1
	help
	  This option allows to select the accelerometer range of this sensor.
	  0 -  2g
	  1 -  4g
	  2 -  8g
	  3 - 16g

config MPU6000_FS_SEL
	int "Gyrometer Full Scale Selection"
	range 0 3
	default 1
	help
	  This option allows to select the gyrometer range of this sensor.
	  0 -  250 deg/s
	  1 -  500 deg/s
	  2 - 1000 deg/s
	  3 - 2000 deg/s 

config MPU6000_DLPF_CONFIG
	int "Digital Low Pass filter settings"
	range 0 6
	default 0
	help
	  This option allows to configure the integrated digital low pass filter
	  0 - disabled
	  1 - acc: 184 Hz, gyro: 188 Hz
	  2 - acc:  94 Hz, gyro:  89 Hz
	  3 - acc:  44 Hz, gyro:  42 Hz
	  4 - acc:  21 Hz, gyro:  20 Hz
	  5 - acc:  10 Hz, gyro:  10 Hz
	  6 - acc:   5 Hz, gyro:   5 Hz

endif # MPU6000_DRIVER
```

## drivers/rc/Kconfig
```kconfig
# Copyright (c) 2022 Jonathan Hahn
# SPDX-License-Identifier: Apache-2.0

rsource "rc_common/Kconfig"
rsource "joystick/Kconfig"
rsource "sbus/Kconfig"
rsource "srxl2/Kconfig"
```

## drivers/rc/joystick/Kconfig
```kconfig
config ZEPHLY_JOYSTICK_RC_DRIVER
    bool "Joytick RC driver for native posix"
    depends on ZEPHLY_RC_COMMON
    help
      Enable Joystick RC driver. It incorporates SDL2 to
      read the system's first joystick and provide its inputs
      as regular rc input for zephly.


if ZEPHLY_JOYSTICK_RC_DRIVER

config ZEPHLY_JOYSTICK_RC_INIT_PRIORITY
	int "Joystick init priority"
	default 80
	help
	  Joystick initialization priority.

endif #ZEPHLY_JOYSTICK_RC_DRIVER
```

## drivers/rc/rc_common/Kconfig
```kconfig
# Copyright (c) 2022 Jonathan Hahn
# SPDX-License-Identifier: Apache-2.0

config FFC_RC_COMMON
    bool "Common rc driver stuff"
    help
        Enable common functions used for rc drivers.
```

## drivers/rc/sbus/Kconfig
```kconfig
# Copyright (c) 2022 Jonathan Hahn
# SPDX-License-Identifier: Apache-2.0

config ZEPHLY_SBUS_RC_DRIVER
    bool "RC S.Bus driver"
    depends on ZEPHLY_RC_COMMON
    depends on UART_USE_RUNTIME_CONFIGURE
    depends on UART_INTERRUPT_DRIVEN
    help
      Enable S.Bus RC receiver driver.
```

## drivers/rc/srxl2/Kconfig
```kconfig
# Copyright (c) 2022 Jonathan Hahn
# SPDX-License-Identifier: Apache-2.0

config ZEPHLY_SRXL2_RC_DRIVER
    bool "RC (SRXL2) driver"
    depends on ZEPHLY_RC_COMMON
    help
      Enable SRXL2 driver.
```

## lib/Kconfig
```kconfig
# Copyright (c) 2022 Jonathan Hahn
# SPDX-License-Identifier: Apache-2.0

menu "Libraries"

rsource "com/Kconfig"
rsource "control/Kconfig"
rsource "mixer/Kconfig"
rsource "simulator_connection/Kconfig"

endmenu
```

## lib/com/Kconfig
```kconfig
# Copyright (c) 2022 Jonathan Hahn
# SPDX-License-Identifier: Apache-2.0

menu "Communication"

rsource "sbus/Kconfig"

endmenu
```

## lib/com/sbus/Kconfig
```kconfig
# Copyright (c) 2022 Jonathan Hahn
# SPDX-License-Identifier: Apache-2.0

config ZEPHLY_SBUS_LIB
    bool "Servo Bus parsing library"
    help
      Enable the library for parsing SBus communication.
```

## lib/control/Kconfig
```kconfig
# Copyright (c) 2022 Jonathan Hahn
# SPDX-License-Identifier: Apache-2.0

config ZEPHLY_CONTROL_LIB
    bool "PID control library"
    help
      Enable the ffc pid control library.
```

## lib/mixer/Kconfig
```kconfig
config FFC_MIXER_LIB
    bool "Mixer library"
    help
      Enable the ffc mixer library.
```

## lib/simulator_connection/Kconfig
```kconfig
# Copyright (c) 2022 Jonathan Hahn
# SPDX-License-Identifier: Apache-2.0

config ZEPHLY_SIMULATOR_CONNECTION
    bool "Simulator Connection"
    help
      Enable the simulator connection on native builds on host machine.
```
