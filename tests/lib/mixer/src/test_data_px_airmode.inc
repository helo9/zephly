/* This is a automatically created file, do not alter. See Mixing.ipynb */

const float test_data_airmode[54][12] = {
	{-1.0000000000000000f, -1.0000000000000000f, -1.0000000000000000f, 1.0000000000000000f, 0.0000000000000000f, 0.0000000000000000f, 1.0000000000000000f, 0.0000000000000000f, -0.2500000000000000f, -0.2500000000000000f, -0.2500000000000000f, 0.2500000000000000f, },
	{-1.0000000000000000f, -1.0000000000000000f, 1.0000000000000000f, 1.0000000000000000f, 0.0000000000000000f, 1.0000000000000000f, 1.0000000000000000f, 1.0000000000000000f, -0.2500000000000000f, -0.2500000000000000f, 0.2500000000000000f, 0.7500000000000000f, },
	{-1.0000000000000000f, 1.0000000000000000f, 1.0000000000000000f, 1.0000000000000000f, 0.0000000000000000f, 0.0000000000000000f, 0.0000000000000000f, 1.0000000000000000f, -0.2500000000000000f, 0.2500000000000000f, 0.2500000000000000f, 0.2500000000000000f, },
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	{0.5439464627773609f, 0.3972107964271996f, 0.4884009498574020f, -0.2728782428125618f, 1.0000000000000000f, 1.0000000000000000f, 0.0000000000000000f, 1.0000000000000000f, 0.2500000000000000f, 0.2500000000000000f, 0.2500000000000000f, 0.7500000000000000f, },
};
