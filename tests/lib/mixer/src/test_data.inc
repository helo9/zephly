float test_data[25][8] = {
    {0.000000000000f, 0.000000000000f, 0.000000000000f, 0.000000000000f, 0.000000000000f, 0.000000000000f, 0.000000000000f, 0.000000000000f},
    {0.000000000000f, 0.000000000000f, 0.000000000000f, 1.000000000000f, 1.000000000000f, 1.000000000000f, 1.000000000000f, 1.000000000000f},
    {0.000000000000f, 0.000000000000f, 1.000000000000f, 1.000000000000f, 0.000000000000f, 1.000000000000f, 0.000000000000f, 1.000000000000f},
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    {0.631466966478f, 0.076482560578f, 0.433796092997f, 0.088561039766f, 0.362714473825f, 1.000000000000f, 0.000000000000f, 0.000000000000f}
};
