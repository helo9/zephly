const float test_data_ratecontrol[10][7] = {
	{0.0000000000000000f, 0.0000000000000000f, 0.0000000000000000f, 0.0000000000000000f, -0.0000000000000000f, 0.0000000000000000f, 0.0000000000000000f, },
	{1.0000000000000000f, 0.0000000000000000f, 20.0000000000000000f, 0.0000000000000000f, -0.0000000000000000f, 0.1000000000000000f, 20.0000000000000000f, },
	{1.0000000000000000f, 0.0000000000000000f, 20.0000000000000000f, 0.1000000000000000f, -0.0000000000000000f, 0.2000000000000000f, 20.1000000000000014f, },
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	{-1.0000000000000000f, -0.0000000000000000f, -20.0000000000000000f, 0.1700000000000000f, -0.0000002395206748f, 0.0700000000000000f, -19.8300002395206718f, },
};
