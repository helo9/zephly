## CMakeLists.txt
```
# Find Zephyr. This also loads Zephyr's build system.
cmake_minimum_required(VERSION 3.20)

find_package(Zephyr REQUIRED HINTS $ENV{ZEPHYR_BASE})
project(gyro_tuning)

target_sources(app PRIVATE src/main.c)
target_include_directories(app PUBLIC include)
```

## sample.yaml
```
sample:
  name: Gyro tuning sample
  description:  |
    This application collects gyro measurements and sends
    them out in binary form via UART to allow for signal
    analysis and filter tuning.
tests:
  ffc.drivers.mpu600:
    build_only: true
    platform_allow: openpilot_cc3d
```

## prj.conf
```kconfig
CONFIG_SPI=y
CONFIG_GPIO=y
CONFIG_SENSOR=y
CONFIG_MPU6000_DRIVER=y
CONFIG_MPU6000_DLPF_CONFIG=4

CONFIG_NEWLIB_LIBC=y
CONFIG_NEWLIB_LIBC_FLOAT_PRINTF=y

CONFIG_CONSOLE=y
CONFIG_UART_CONSOLE=y
```

## boards/openpilot_cc3d.overlay
```dts
/*
 * Copyright (c) 2022 Jonathan Hahn
 *
 * SPDX-License-Identifier: Apache-2.0
 */

&usart1 {
    /delete-property/ single-wire;
    /delete-node/ srxl2;
    current-speed = <230400>;
};
```

## src/main.c
```c
/* main.c - Sample sending gyro measurements via UART to host. */

/*
 * Copyright (c) 2022 Jonathan Hahn
 *
 * SPDX-License-Identifier: Apache-2.0
 */

#include "kernel.h"
#include <zephyr.h>
#include <devicetree.h>
#include <drivers/uart.h>
#include <drivers/sensor.h>
#include <stdint.h>
#include <gyro_msg.h>

#define SYNC_BYTE 0xAA

#define CONSUMER_STACK_SIZE 500
#define CONSUMER_STACK_PRIO 5

K_MSGQ_DEFINE(measurement_queue, sizeof(union measurement_msg), 10, 4);

static inline int32_t sensor_value_to_int(const struct sensor_value *val) {
    return (int32_t)(val->val1 * 10000) + (int32_t)(val->val2 / 100);
}

/* Consumer Thread with msg queue */

extern void consumer_run(void *, void *, void *);

K_THREAD_DEFINE(my_tid, CONSUMER_STACK_SIZE,
            consumer_run, NULL, NULL, NULL,
            CONSUMER_STACK_PRIO, 0, 0);

/* Producer runs with timer and regularly catches sensor measurements */

void produce_measurement(struct k_work *work);

K_WORK_DEFINE(measurement_work, produce_measurement);

void measurement_timer_handler(struct k_timer *timer_id);

K_TIMER_DEFINE(producer_timer, measurement_timer_handler, NULL);

/* Devieces */

#define UART_NODE DT_NODELABEL(usart1)
#define GYRO_NODE DT_NODELABEL(imu)

const struct device *uart = DEVICE_DT_GET(UART_NODE);
const struct device *gyro = DEVICE_DT_GET(GYRO_NODE);

void main() {

    printk("Starting initialization");

    if (!device_is_ready(gyro)) {
        printk("Gyro is not ready!");
        return;
    }

    printk("..");

    if (!device_is_ready(uart)) {
        printk("Uart is not ready!");
        return;
    }

    printk("..");

    k_timer_start(&producer_timer, K_MSEC(1), K_MSEC(1));

    printk("done\n");


    while (true) {
        //printk("Hello my dear friend ;)\n");
        k_sleep(K_MSEC(5000));
    }
}

extern void consumer_run(void *_, void *__, void *___)
{
    union measurement_msg data = {};

    while (true) {
        k_msgq_get(&measurement_queue, &data, K_FOREVER);

        const int len = sizeof(data);

        uart_poll_out(uart, (char)SYNC_BYTE);
        uart_poll_out(uart, (char)SYNC_BYTE);
        uart_poll_out(uart, (char)len);
        for (int i=0; i<len; i++) {
            uart_poll_out(uart, data.raw[i]);
        }
    }
}

void measurement_timer_handler(struct k_timer *timer) {
    k_work_submit(&measurement_work);
}

void produce_measurement(struct k_work *work) {
    struct sensor_value measurements[3];
    sensor_sample_fetch(gyro);
    sensor_channel_get(gyro, SENSOR_CHAN_GYRO_XYZ, measurements);

    union measurement_msg data = {
        .values = {
            (uint16_t)k_uptime_get(),
            sensor_value_to_int(&measurements[0]),
            sensor_value_to_int(&measurements[1]),
            sensor_value_to_int(&measurements[2])
        }
    };

    k_msgq_put(&measurement_queue, &data, K_NO_WAIT);
}
```

## include/gyro_msg.h
```c
#include <stdint.h>

#ifndef SAMPLE_MSG_H
#define SAMPLE_MSG_H

union  measurement_msg {
        struct __attribute__((__packed__)) {
            uint16_t ts : 16;
            int32_t gyro_x : 20;
            int32_t gyro_y : 20;
            int32_t gyro_z : 20;
        } values;
        uint8_t raw[10];
};

#endif /* SAMPLE_MSG_H */
```
